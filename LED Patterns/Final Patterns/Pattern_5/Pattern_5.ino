int bulbs[25] = {26, 27, 24, 25, 22, 33, 30, 31, 28, 29, 36, 37, 34, 35, 32, 43, 40, 41, 38, 39, 46, 47, 44, 45, 42};
int layers[5] = {52, 53, 50, 51, 48};
int const frames = 10;

void setup() {
  
 for(int i=22;i<=53;i++){
  pinMode(i,OUTPUT);
  
 }
}

void loop() {


int frame[frames][125] = {
  {1,0,0,0,0,1,0,0,0,0,1,0,0,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0,1},
  {0,0,1,0,0,0,0,1,0,0,0,0,1,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0,0},
  {0,0,0,0,1,0,0,0,0,1,0,0,0,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0,0},
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  {1,0,0,0,0,1,0,0,0,0,1,0,0,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0,1},
  
                         
                            };
for (int i = 0; i < frames; i++) {
  lightFrame(frame[i]);
}

}



void lightFrame(int frame[125]) {
  for (int i = 0; i < 50; i++) {
    for (int l = 0; l < 5; l++) {
     
      int k = 0;
      for (int j = l * 5; j < 125; j += 25) {
        for (int r = 0; r < 5; r++) {
          if (frame[j + r] == 1) {
            digitalWrite(bulbs[k], HIGH);
          } else {
            digitalWrite(bulbs[k], LOW);
          }
          k++;
        }
      } 
      digitalWrite(layers[l], HIGH);
      delay(1);
      digitalWrite(layers[l], LOW);
    }
  }    
}



